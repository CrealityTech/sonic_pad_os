## package/testunit/basic/storage/Config.in
```kconfig
menuconfig TESTUNIT_BASIC_STORAGE
    bool "storage"
    default y
        select TINATEST_SPEC
        select TINATEST_SPEC_STORAGE
        select TINATEST_SPEC_STORAGE_RAND_ENABLE
        select TINATEST_SPEC_STORAGE_SEQ_ENABLE
        select TINATEST_SPEC_STORAGE_TINY_SEQ_ENABLE
        select TINATEST_STRESS
        select TINATEST_STRESS_STORAGE
        select TINATEST_STRESS_STORAGE_FULLDISK_ENABLE
        select TINATEST_STRESS_STORAGE_POWER_FAIL_ENABLE
        select TINATEST_STRESS_STORAGE_THROUGHPUT_ENABLE
        select PACKAGE_MtpDaemon
```

## package/testunit/basic/tool/Config.in
```kconfig
menuconfig TESTUNIT_BASIC_TOOL
    bool "tool"
    default y
        select PACKAGE_TINATEST
	select TINATEST_SYS_GLOBAL
	select TINATEST_SYS_GLOBAL_INFO
	select TINATEST_SYS_GLOBAL_INFO_OUTLOG
        select TINATEST_SYS_GLOBAL_INFO_OUTLOG_DRAGONMAT
```

## package/testunit/camera/Config.in
```kconfig
menuconfig TESTUNIT_CAMERA
    bool "camera"
	select PACKAGE_camerademo
	select ENABLE_VIN_ISP
```

## package/testunit/display/Config.in
```kconfig
menuconfig TESTUNIT_DISPLAY
    bool "display"
	select PACKAGE_smart-music-player
```

## package/testunit/multimedia/Config.in
```kconfig
menuconfig TESTUNIT_MULTIMEDIA
    bool "multimedia"
	select PACKAGE_tplayerdemo
	select PACKAGE_trecorderdemo
	select PACKAGE_jpegdecodedemo
```

## package/testunit/network/Config.in
```kconfig
menuconfig TESTUNIT_NETWORK
    bool "network"
    default y

if TESTUNIT_NETWORK
    source wifi/Config.in
    source bt/Config.in
endif
```

## package/testunit/network/wifi/Config.in
```kconfig
menuconfig TESTUNIT_NETWORK_WIFI
    bool "wifi"
    default y
    select PACKAGE_wifimanager
    select PACKAGE_wifimanager-demo
    select PACKAGE_wpa-cli
    select PACKAGE_wpa-supplicant
    select PACKAGE_iperf
    select PACKAGE_softap
    select PACKAGE_softap-demo
    select PACKAGE_smartlinkd-demo
    select PACKAGE_smartlinkd-lib
    select XRADIO_SMARTCONFIG
    select SOFT_AP
    select SOUND_WAVE
```
