## lichee/arisc/coco/coco/arch/openrisc/Kconfig
```kconfig
choice PLATFORM
	prompt "Sunxi-chip to use"
	help
	the ic we use for build

config SUN50IW6P1
	bool
	imply CPUX_ARM64
	select OPENRISC
	prompt "AW1728 sun50iw6p1 H6 platform"

config SUN8IW12P1
	bool
	imply CPUX_ARM32
	select OPENRISC
	prompt "AW1721 sun8iw12p1 V5 platform"

config SUN8IW15P1
	bool
	imply CPUX_ARM32
	select OPENRISC
	prompt "AW1755 sun8iw15p1 A50/R311/MR133 platform"

config SUN8IW16P1
	bool
	imply CPUX_ARM32
	select OPENRISC
	select COCO_OS
	prompt "AW1816 sun8iw16p1 V5V200 platform"

endchoice

choice PLATFORM_SELECT
	prompt "Platform used"

config EVB_FLATFORM
	bool "evb platfrom used"

config FPGA_FLATFORM
	bool "fpga platform used"

endchoice





source "coco/driver/dram/Kconfig"
```

## lichee/arisc/coco/coco/driver/Kconfig
```kconfig
menu "Device Drivers"

source "coco/driver/pmu/Kconfig"

source "coco/driver/rsb/Kconfig"

config HWCPUIDLE_USED
	def_bool n
	prompt "Hardware cpu idle used"

endmenu
```

## lichee/arisc/coco/coco/driver/dram/Kconfig
```kconfig
source "coco/driver/dram/dram_sun8iw16p1/Kconfig"

config HAVE_DDR_SEL_SUPPORT
	bool

config HAVE_DDR3_SUPPORT
	bool

config HAVE_DDR4_SUPPORT
	bool

config HAVE_LPDDR3_SUPPORT
	bool

config HAVE_LPDDR4_SUPPORT
	bool

choice DDR_TYPE_USED
	prompt  "DDR type used"
	depends on HAVE_DDR_SEL_SUPPORT

	config DDR3
	bool "ddr3"
	depends on HAVE_DDR3_SUPPORT

	config DDR4
	bool "ddr4"
	depends on HAVE_DDR4_SUPPORT

	config LPDDR3
	bool "lpddr3"
	depends on HAVE_LPDDR3_SUPPORT

	config LPDDR4
	bool "lpddr4"
	depends on HAVE_LPDDR4_SUPPORT

endchoice

config DDR_TYPE
	string
	default "ddr3" if DDR3
	default "ddr4" if DDR4
	default "lpddr3" if LPDDR3
	default "lpddr4" if LPDDR4
```

## lichee/arisc/coco/coco/driver/dram/dram_sun8iw16p1/Kconfig
```kconfig
config SUN8IW16P1
	select HAVE_DDR_SEL_SUPPORT
	select HAVE_DDR3_SUPPORT
	select HAVE_DDR4_SUPPORT
	select HAVE_LPDDR3_SUPPORT
	select HAVE_LPDDR4_SUPPORT
```

## lichee/arisc/coco/coco/driver/rsb/Kconfig
```kconfig
menuconfig RSB_USED
	def_bool y
	prompt "RSB used"

if RSB_USED

config RSB_HALDWORD_OP
	bool "RSB halfword operator"
config RSB_WORD_OP
	bool "RSB word operator"
config RSB_BYTE_OP
	bool "RSB byte operator"
	default y
endif
```

## lichee/arisc/coco/coco/service/Kconfig
```kconfig
menu "Services"

config RSB_SERVICE
	def_bool y
	prompt "RSB service support"
	select RSB_USED

config STANDBY_POWER
	def_bool y
	prompt "Standby power support"

config DVFS_SERVICE
	def_bool n
	prompt "DVFS service support"

if DVFS_SERVICE
	config DVFS_CPU
		def_bool n
		prompt "CPU DVFS"

	config DVFS_DRAM
		def_bool n
		prompt "DRAM DVFS"

	if DVFS_CPU
		config DVFS_USED
			def_bool n
			prompt "CPU DVFS way used"

		help
			CPU DVFS has two ways: DVFS way and AVS way.
			Say Y here to use DVFS way, otherwise to use AVS way.
	endif
endif

endmenu
```

## lichee/arisc/coco/coco/system/debug/Kconfig
```kconfig
menu "Debug function"

comment "debug printk function"

config DEBUGGER_PRINTF
	bool "debugger printf support"
	default y

if DEBUGGER_PRINTF

config DEBUG_ERR
	bool "err debug support"
	default y

config DEBUG_LOG
	bool "log debug support"
	default y

config DEBUG_WRN
	bool "warn debug support"
	default y

config DEBUG_INF
	bool "inf debug support"
	default n
endif

comment "shell function"

config SHELL_USED
	def_bool n
	prompt "shell cmd support"
	select DEBUGGER_PRINTF

comment "system debug function"

config SYSTEM_DEBUG
	def_bool n
	prompt "system debug"

endmenu
```

## lichee/brandy-2.0/u-boot-2018/configs/sun50iw12p1_defconfig
```kconfig
CONFIG_ARM=y
CONFIG_ARCH_SUNXI=y
CONFIG_MACH_SUN50IW12=y
#CONFIG_AXP_GPIO=y
CONFIG_SYS_CONFIG_NAME="sun50iw12p1"
CONFIG_DEFAULT_DEVICE_TREE="sun50iw12-soc"
# CONFIG_SYS_MALLOC_CLEAR_ON_INIT is not set
CONFIG_CONSOLE_MUX=y
CONFIG_PRE_CONSOLE_BUFFER=n
CONFIG_OF_BOARD=y
#CONFIG_OF_SEPARATE=y
CONFIG_SYS_TEXT_BASE=0x43000000
CONFIG_SUNXI_FDT_ADDR=0x41800000

#system
CONFIG_ARM_SMCCC=y
CONFIG_SUNXI_DMA=y
#I2C
CONFIG_SYS_I2C_SUNXI=y
CONFIG_SYS_SUNXI_I2C_SLAVE=0x50
CONFIG_SYS_SUNXI_I2C_SPEED=400000
CONFIG_I2C0_ENABLE=y
CONFIG_I2C1_ENABLE=y

#axp
#CONFIG_R_I2C0_ENABLE=y
#CONFIG_SYS_SUNXI_R_I2C0_SLAVE=0x34
#CONFIG_SYS_SUNXI_R_I2C0_SPEED=400000
#CONFIG_SUNXI_POWER=y
#CONFIG_SUNXI_PMU=y
#CONFIG_SUNXI_BMU=y
#CONFIG_AXP2585_POWER=y

#key
CONFIG_SUNXI_PHY_KEY=y
CONFIG_SUNXI_LRADC_KEY=y

#crypto driver
CONFIG_SUNXI_CE_DRIVER=y
CONFIG_SUNXI_CE_23=y

CONFIG_SF_DEFAULT_SPEED=50000000
# BIT(12) BIT(13) (SPI_RX_DUAL|SPI_RX_QUAD)
CONFIG_SF_DEFAULT_MODE=0x3000

#
# PWM_SUNXI
#
# CONFIG_PWM_SUNXI is not set
CONFIG_PWM_SUNXI_NEW=y

CONFIG_SPINOR_UBOOT_OFFSET=128
CONFIG_SPINOR_LOGICAL_OFFSET=2016

# flash
CONFIG_SUNXI_SDMMC=y
CONFIG_MMC=y
CONFIG_SUNXI_FLASH=y
CONFIG_SUNXI_NAND=y
CONFIG_CMD_SUNXI_NAND=y
CONFIG_SUNXI_COMM_NAND_V1=y

#usb otg config
CONFIG_SUNXI_USB=y
CONFIG_SUNXI_EFEX=y
#CONFIG_SUNXI_BURN=y
CONFIG_SUNXI_FASTBOOT=y
#partition
CONFIG_EFI_PARTITION=y

#image
CONFIG_ANDROID_BOOT_IMAGE=y

#sprite
CONFIG_SUNXI_SPRITE=y
CONFIG_SUNXI_SECURE_STORAGE=y

#cmd
CONFIG_CMD_SUNXI_TIMER=y
CONFIG_CMD_SUNXI_SPRITE=y
CONFIG_CMD_SUNXI_EFEX=y
CONFIG_CMD_SUNXI_BURN=y
CONFIG_CMD_GPT=y
CONFIG_CMD_FAT=y
CONFIG_CMD_FASTBOOT=y
CONFIG_CMD_SUNXI_DMA=y
CONFIG_CMD_SUNXI_MEMTEST=y
CONFIG_CMD_PART=y
CONFIG_CMD_SUNXI_AUTO_FEL=n
CONFIG_CMD_SUNXI_BOOTR=y
#arisc
CONFIG_SUNXI_ARISC_EXIST=y

#secure
CONFIG_SUNXI_SECURE_BOOT=y
CONFIG_SUNXI_IMAGE_VERIFIER=y
CONFIG_SUNXI_KEYBOX=y
CONFIG_SUNXI_DRM_SUPPORT=y

CONFIG_SUNXI_MIPS=y
```

## lichee/linux-4.9/drivers/misc/cmsis-dap/Kconfig
```kconfig
comment "CMSIS-DAP Project module"

config CMSIS_DAP
	tristate "CMSIS_DAP Project to program target flash through SWD"
	depends on GPIOLIB
	default n
	help
	  An "CMSIS-DAP module. Say Y when you want to support this tool.
```

## lichee/linux-4.9/drivers/soc/sunxi/Kconfig
```kconfig
#
# Allwinner sunXi SoC drivers
#
menuconfig SOC_SUNXI
	bool "SUNXI SoC drivers support"

if SOC_SUNXI

config SUNXI_SRAM
	tristate "Sunxi sram support"
	help
	  Say y here to enable the SRAM controller support. This
	  device is responsible on mapping the SRAM in the sunXi SoCs
	  whether to the CPU/DMA, or to the devices.

config SUNXI_SUSPEND
	tristate "Sunxi suspend support"
	default ARCH_SUNXI
	depends on PM_SLEEP
	help
	  Say y here to enable the sunxi standby support.

config SUNXI_SUSPEND_NONARISC
	tristate "Sunxi suspend support without arisc"
	depends on SUNXI_SUSPEND && !SUNXI_ARISC
	default !SUNXI_ARISC
	help
	  Say y here to enter standby without arisc.

config GPU_PM_DOMAINS
	bool "Allwinner gpu power domain"
	depends on PM
	depends on ARCH_SUN50IW10
	select PM_GENERIC_DOMAINS
	select PM_GENERIC_DOMAINS_OF
	help
	 Say y here to enable power domain support.
	 In order to meet high performance and low power requirements, a power
	 management unit is designed or saving power when gpu in low power
	 mode. The PPU is dedicated for managing the power of the GPU.

	 If unsure, say N.

source "drivers/soc/sunxi/arisc/Kconfig"
endif # SOC_SUNXI
```

## package/allwinner/tina_multimedia/trecorder/Config.in
```kconfig
config DEFAULT_SOUNDCARD
    int
    prompt "Choose default card"
        depends on TRECORDER
        default 0
        help
            Choose which soundcard to recorder.

config DEFAULT_DEVICE
    int
    prompt "Choose default pcm device"
        depends on TRECORDER
        default 0
        help
            Choose which pcm device to recorder.
```

## package/littlevgl/smartva/Config.in
```kconfig
if PACKAGE_smartva

config lvgl
    bool "Enabel lvgl core"
    default y
        help
	lvgl core

config lv_drivers
    bool "Enabel lvgl drivers"
    default y
        help
	lvgl drivers

config lv_examples
    bool "Enabel lvgl examples"
    default y
        help
	lvgl examples

config story
    bool "Enabel story"
    default y
        help
	story-machine: 800X480 screen
endif
```

## package/testtools/tinatest/config/base/bt/Config.in
```kconfig
menuconfig TINATEST_BASE_BT
    bool "bt"

if TINATEST_BASE_BT
    source bt_on/Config.in
    source bt_off/Config.in
endif
```

## package/testtools/tinatest/config/base/ethnet/Config.in
```kconfig
menuconfig TINATEST_BASE_ETHNET
    bool "ethnet"

if TINATEST_BASE_ETHNET
    source ethdhcp/Config.in
    source ethping/Config.in
endif
```

## package/testtools/tinatest/config/base/production/uarttester/Config.in
```kconfig
menuconfig TINATEST_BASE_PRODUCTION_UARTTESTER_ENABLE
    bool "uarttester"
    default y
    ---help---
        Settings for /base/production/uarttester
        It safe to leave a blank for any settings.
        If not setted, TinaTest will use global settings or default settings instead.

if TINATEST_BASE_PRODUCTION_UARTTESTER_ENABLE
    config TINATEST_BASE_PRODUCTION_UARTTESTER_COMMAND
        default "uarttester"
    config TINATEST_BASE_PRODUCTION_UARTTESTER_STDIN
        default ""
    config TINATEST_BASE_PRODUCTION_UARTTESTER_FSTDIN
        default ""
    config TINATEST_BASE_PRODUCTION_UARTTESTER_DATE
        default y if TINATEST_SYS_LOCAL_INFO_DATE
    config TINATEST_BASE_PRODUCTION_UARTTESTER_RESOURCE
        default y if TINATEST_SYS_LOCAL_INFO_RESOURCE
    config TINATEST_BASE_PRODUCTION_UARTTESTER_REAL_TIME_LOG
        default y if TINATEST_SYS_LOCAL_INFO_REAL_TIME_LOG
    config TINATEST_BASE_PRODUCTION_UARTTESTER_RUN_TIMES
        default 1
    config TINATEST_BASE_PRODUCTION_UARTTESTER_RUN_ALONE
        default y if TINATEST_SYS_LOCAL_LIMIT_RUN_ALONE
    config TINATEST_BASE_PRODUCTION_UARTTESTER_RUN_PARALLEL
        default y if TINATEST_SYS_LOCAL_LIMIT_RUN_PARALLEN
    config TINATEST_BASE_PRODUCTION_UARTTESTER_MAY_REBOOT
        default y if TINATEST_SYS_LOCAL_LIMIT_MAY_REBOOT
    config TINATEST_BASE_PRODUCTION_UARTTESTER_TESTCASE_RUN_ONCE_TIME
        default "20"
    config TINATEST_BASE_PRODUCTION_UARTTESTER_TESTCASE_RUN_TIME
        default ""
    config TINATEST_BASE_PRODUCTION_UARTTESTER_TIMEOUT_AS_FAILED
        default n
    config TINATEST_BASE_PRODUCTION_UARTTESTER_EXIT_ONCE_FAILED
        default n

    config TINATEST_BASE_PRODUCTION_UARTTESTER_UART_PORT
        int "uart_port"
        default 2

    config TINATEST_BASE_PRODUCTION_UARTTESTER_UART_BAUD
        int "uart_baud"
        default 115200

    config TINATEST_BASE_PRODUCTION_UARTTESTER_TEST_CYCLES
        int "test_cycles"
        default 10

    config TINATEST_BASE_PRODUCTION_UARTTESTER_TEST_BYTES_PER_CYCLE
        int "test_bytes_per_cycle"
        default 128

    comment "Advanced Customized"
    config TINATEST_BASE_PRODUCTION_UARTTESTER_ADVANCED
        bool "Advanced"

    if TINATEST_BASE_PRODUCTION_UARTTESTER_ADVANCED
        config TINATEST_BASE_PRODUCTION_UARTTESTER_COMMAND
            string "command"
            ---help---
                TinaTest will run this command to start testcase.
                It is the same as shell command which followed by argumemts.
                This setting is a mark of any testcase.

        config TINATEST_BASE_PRODUCTION_UARTTESTER_STDIN
            string "stdin"
            ---help---
                Redirect a string array, which is setted in this configure, to standard input.
                For example,
                "one two three four" is equivalent to enter 4 times to testcase every run_time.
                The first time, enter "one" with new line,
                the second time, enter "two" with new line, and so on.

        config TINATEST_BASE_PRODUCTION_UARTTESTER_FSTDIN
            string "fstdin"
            ---help---
                Redirect a file, which is setted in this configure, to standard input.

        config TINATEST_BASE_PRODUCTION_UARTTESTER_INFO
            bool "INFO"
            default y

        if TINATEST_BASE_PRODUCTION_UARTTESTER_INFO
            config TINATEST_BASE_PRODUCTION_UARTTESTER_DATE
                bool "date"
                ---help---
                    Save running date and time.

            config TINATEST_BASE_PRODUCTION_UARTTESTER_RESOURCE
                bool "resource"
                ---help---
                    Save resources for each testcase.

            config TINATEST_BASE_PRODUCTION_UARTTESTER_REAL_TIME_LOG
                bool "real_time_log"
                ---help---
                    Print log of testcase real time.
                    In default, tinatest just collect all log, and print them when testcase end.
        endif

        config TINATEST_BASE_PRODUCTION_UARTTESTER_LIMIT
            bool "LIMIT"
            default y

        if TINATEST_BASE_PRODUCTION_UARTTESTER_LIMIT
            config TINATEST_BASE_PRODUCTION_UARTTESTER_RUN_TIMES
                int "run_times"
                ---help---
                    The times to run testcase.
                    For example:
                    To run this testcase for 3 times, we can set this value as 3.

            config TINATEST_BASE_PRODUCTION_UARTTESTER_RUN_ALONE
                bool "run_alone"
                ---help---
                    Wait for finishing all previous testcase and run alone before do next.

            config TINATEST_BASE_PRODUCTION_UARTTESTER_RUN_PARALLEL
                bool "run_parallel"
                ---help---
                    Run parallel for all run_times.
                    For example:
                    Testcae will run for 3 times one by one if run_times=3.
                    However, if run_parallel is setted, tinatest will creates 3 processers
                    in one time.

            config TINATEST_BASE_PRODUCTION_UARTTESTER_MAY_REBOOT
                bool "may_reboot"
                ---help---
                    It means that device will be rebooted while running testcase.
                    All states of testcase will be saved in flash, and loaded after rebooting.
                    Notices that, if may_reboot is setted, run_alone will be setted alway.

            config TINATEST_BASE_PRODUCTION_UARTTESTER_TESTCASE_RUN_ONCE_TIME
                string "testcase_run_once_time"
                ---help---
                    Time limit for testcase to run once.
                    It is in format:
                        <sec> <min> <hour> <day>
                    For example,
                    100s : 100
                    1m20s : 20 1 (or 80)
                    1d3h : 0 0 3 1 (or 0 0 28 or other)

            config TINATEST_BASE_PRODUCTION_UARTTESTER_TESTCASE_RUN_TIME
                string "testcase_run_time"
                ---help---
                    Time limit for testcase to run.
                    It is in format:
                        <sec> <min> <hour> <day>
                    For example,
                    100s : 100
                    1m20s : 20 1 (or 80)
                    1d3h : 0 0 3 1 (or 0 0 28 or other)

            config TINATEST_BASE_PRODUCTION_UARTTESTER_TIMEOUT_AS_FAILED
                bool "timeout_as_failed"
                ---help---
                    Seem to failed when testcase exit for timeout.
                    If not set, default as pass.

            config TINATEST_BASE_PRODUCTION_UARTTESTER_EXIT_ONCE_FAILED
                bool "exit_once_failed"
                ---help---
                    Stop running testcase and exit once failed,
                    even if runned times less than run_times.
        endif
    endif
endif
```

## package/testtools/tinatest/config/sys/global/info/language/Config.in
```kconfig
menuconfig TINATEST_SYS_GLOBAL_INFO_LANG
    bool "language"
    default n

if TINATEST_SYS_GLOBAL_INFO_LANG
choice
	prompt "TinaTest Language"
	default TINATEST_SYS_GLOBAL_INFO_LANG_EN

config TINATEST_SYS_GLOBAL_INFO_LANG_en
	bool "English"

config TINATEST_SYS_GLOBAL_INFO_LANG_zh
	bool "Chiness"

endchoice
endif
```
