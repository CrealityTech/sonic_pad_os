## package/testtools/tinatest/config/sys/global/info/outlog/Config.in
```kconfig
menuconfig TINATEST_SYS_GLOBAL_INFO_OUTLOG
    bool "outlog"
    default y

if TINATEST_SYS_GLOBAL_INFO_OUTLOG
    source serial/Config.in
    source markdown/Config.in
    source dragonmat/Config.in
endif


config TINATEST_INTERACT_API
	bool "interact api"
	default y
	help
		config if open interact api(such as task, ttrue).

config TINATEST_INTERACT_TTIPS
	bool "ttips api"
	default y
	help
		config if open ttips api.
```

## package/testunit/Config.in
```kconfig
if PACKAGE_testunit
    comment "Settings For TESTUNIT"
    source basic/Config.in
    source camera/Config.in
    source audio/Config.in
    source network/Config.in
    source display/Config.in
    source multimedia/Config.in
endif
```

## package/testunit/audio/Config.in
```kconfig
menuconfig TESTUNIT_AUDIO
    bool "audio"
	select PACKAGE_alsa-utils
	select PACKAGE_tinymp3
```

## package/testunit/basic/Config.in
```kconfig
menuconfig TESTUNIT_BASIC
    bool "basic"
    default y

if TESTUNIT_BASIC
    source cpu/Config.in
    source storage/Config.in
    source tool/Config.in
endif
```

## package/testunit/basic/cpu/Config.in
```kconfig
menuconfig TESTUNIT_BASIC_CPU
    bool "cpu"
    default y
	select PACKAGE_benchmarks
	select BENCHMARKS_LINPACK
```
