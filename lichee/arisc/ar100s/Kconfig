## lichee/arisc/ar100s/Kconfig
```kconfig
mainmenu "ar100s cpus config"

source "arch/Kconfig"

source "driver/Kconfig"

source "service/Kconfig"

source "system/Kconfig"
```

## lichee/arisc/ar100s/arch/Kconfig
```kconfig
config CPUX_ARM32
	bool

config CPUX_ARM64
	bool

config OPENRISC
	bool

config AR100S_OS
	bool

source "arch/openrisc/Kconfig"
```

## lichee/arisc/ar100s/arch/openrisc/Kconfig
```kconfig
choice PLATFORM
	prompt "Sunxi-chip to use"
	help
	the ic we use for build

config SUN50IW6P1
	bool
	imply CPUX_ARM64
	select OPENRISC
	prompt "AW1728 sun50iw6p1 H6 platform"

config SUN50IW10P1
	bool
	imply CPUX_ARM64
	select OPENRISC
	select AR100S_OS
	prompt "AW1855 sun50iw10p1 A100 platform"

config SUN50IW12P1
	bool
	imply CPUX_ARM64
	select OPENRISC
	select AR100S_OS
	prompt "AW1860 sun50iw12p1 TV303 platform"

config SUN8IW12P1
	bool
	imply CPUX_ARM32
	select OPENRISC
	prompt "AW1721 sun8iw12p1 V5 platform"

config SUN8IW15P1
	bool
	imply CPUX_ARM32
	select OPENRISC
	prompt "AW1755 sun8iw15p1 A50/R311/MR133 platform"

config SUN8IW16P1
	bool
	imply CPUX_ARM32
	select OPENRISC
	prompt "AW1816 sun8iw16p1 V5V200 platform"

endchoice

choice PLATFORM_SELECT
	prompt "Platform used"

config EVB_PLATFORM
	bool "evb platfrom used"

config FPGA_PLATFORM
	bool "fpga platform used"

endchoice
```

## lichee/arisc/ar100s/driver/Kconfig
```kconfig
menu "Device Drivers"

source "driver/pmu/Kconfig"

source "driver/twi/Kconfig"

source "driver/hwmsgbox/Kconfig"

source "driver/timer/Kconfig"

source "driver/watchdog/Kconfig"

endmenu
```

## lichee/arisc/ar100s/driver/dram/Kconfig
```kconfig
#source "driver/dram/dram-sun50iw6p1/Kconfig"

config HAVE_DDR_SEL_SUPPORT
	bool

config HAVE_DDR3_SUPPORT
	bool

config HAVE_DDR4_SUPPORT
	bool

config HAVE_LRDDR3_SUPPORT
	bool

config HAVE_LRDDR4_SUPPORT
	bool

choice DDR_TYPE
	prompt  "DDR type used"
	depends on HAVE_DDR_SEL_SUPPORT

	config DDR3
	bool "ddr3"
	depends on HAVE_DDR3_SUPPORT

	config DDR4
	bool "ddr4"
	depends on HAVE_DDR4_SUPPORT

	config LRDDR3
	bool "lpddr3"
	depends on HAVE_LRDDR3_SUPPORT

	config LRDDR4
	bool "lpddr4"
	depends on HAVE_LRDDR4_SUPPORT

endchoice
```

## lichee/arisc/ar100s/driver/hwmsgbox/Kconfig
```kconfig
menuconfig MSGBOX_USED
	def_bool y
	prompt "MSGBOX used"

choice MSGBOX_IP
	prompt "Sunxi msgbox to use"

config HW_MSGBOX_USED
	bool
	prompt "Old IP MSGBOX used"
	depends on MSGBOX_USED

config HW_MSGBOX_EXTENDED_USED
	bool
	prompt "New IP MSGBOX used"
	depends on MSGBOX_USED

endchoice
```

## lichee/arisc/ar100s/driver/pmu/Kconfig
```kconfig
menuconfig PMU_USED
	bool
	prompt "PMU used"
	default y

if PMU_USED

config AXP803_USED
	bool "AXP803 used"

config AXP2202_USED
	bool "AXP2202 used"

config AXP806_USED
	bool "AXP806 used"

config AXP858_USED
	bool "AXP858 used"

endif # PMU_USED
```

## lichee/arisc/ar100s/driver/timer/Kconfig
```kconfig
menuconfig TIMER_CONFIG
	def_bool y
	prompt "timer used"

choice TIMER_IP
	prompt "Sunxi mtimer to use"

config TIMER_USED
	bool
	prompt "Old IP TIMER used"
	depends on TIMER_CONFIG

config TIMER_EXTENDED_USED
	bool
	prompt "New IP TIMER used"
	depends on TIMER_CONFIG

endchoice
```

## lichee/arisc/ar100s/service/Kconfig
```kconfig
menu "Services"


config STANDBY_SERVICE
	def_bool y
	prompt "Standby service support"

config FDT_USED
	def_bool y
	prompt "fdt lib support"

endmenu
```

## lichee/arisc/coco/Kconfig
```kconfig
mainmenu "coco cpus config"


source "coco/arch/Kconfig"

source "bytb/Kconfig"

source "coco/Kconfig"
```

## lichee/arisc/coco/bytb/Kconfig
```kconfig
menu "BYTB configs"

config BYTB_DEBUG
	bool "BYTB task debug"
	default n
	---help---
	create a task to debug bytb system

source "bytb/service/Kconfig"

endmenu
```

## lichee/arisc/coco/bytb/service/Kconfig
```kconfig
menu "System service config"

config CIR_WAKEUP
	bool "Ir receive to wakeup system"
	default n

config LOOP_TASK
	bool "Loop system service task"
	default n

source "bytb/service/psci/Kconfig"

endmenu
```

## lichee/arisc/coco/coco/Kconfig
```kconfig
source "coco/driver/Kconfig"
source "coco/system/Kconfig"
source "coco/service/Kconfig"
```

## lichee/arisc/coco/coco/arch/Kconfig
```kconfig
config CPUX_ARM32
	bool

config CPUX_ARM64
	bool

config OPENRISC
	bool

config COCO_OS
	bool

source "coco/arch/openrisc/Kconfig"
```
